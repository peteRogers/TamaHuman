// renderer.h - draws the Tamagotchi's 32x16 LCD onto a 128x64 SSD1306,
// replacing any shape the student has drawn with their own hi-res sprite.
//
// How it works:
//   1. The 32x16 screen is split into "objects" wherever a column is empty.
//   2. Each object's pixels are turned into a hash (a 32-bit fingerprint).
//   3. If that hash is in SPRITES[] (human_sprites.h), the student's drawing is
//      drawn instead. Mirrored poses are matched automatically, so each pose
//      only needs drawing once (facing the way it was captured).
//   4. Otherwise the original pixels are drawn, scaled up, and (in capture
//      mode) the shape is printed over Serial so it can be drawn next.
//
// This file has no Arduino dependencies so it can be tested on a computer.

#pragma once
#include <stdint.h>
#include <stdio.h>

#ifndef SCALE
#define SCALE 3          // 3 = 96x48 game area + icon bars, 4 = full screen 128x64
#endif
#ifndef CAPTURE
#define CAPTURE 1        // 1 = print unknown shapes over Serial
#endif
#ifndef CAPTURE_ALL
#define CAPTURE_ALL 0    // 0 = only pet-sized shapes (4-16 dots wide, 3+ tall), 1 = everything
#endif

namespace tama {

const int TW = 32, TH = 16;            // original LCD size
const int SW = 128, SH = 64;           // SSD1306 size
const int OX = (SW - TW * SCALE) / 2;  // game area offset
const int OY = (SH - TH * SCALE) / 2;

struct Sprite {
  uint32_t hash;         // fingerprint of the original shape
  uint8_t w, h;          // size of the drawing in screen pixels
  const uint8_t *bits;   // 1 bit per pixel, rows left to right, MSB first
};

}  // namespace tama

#include "human_sprites.h"   // generated by tools/make_sprites.py
#include "icons.h"

namespace tama {

typedef void (*PixelFn)(int x, int y);
typedef void (*LogFn)(const char *line);

// ---------- shape fingerprints ----------

static uint32_t shapeHash(const uint8_t lcd[TH][TW], int x0, int x1, int y0, int y1, bool mirror) {
  uint32_t h = 2166136261u;                       // FNV-1a
  auto mix = [&](uint8_t v) { h ^= v; h *= 16777619u; };
  mix(x1 - x0 + 1);
  mix(y1 - y0 + 1);
  for (int y = y0; y <= y1; y++)
    for (int i = 0; i <= x1 - x0; i++)
      mix(lcd[y][mirror ? x1 - i : x0 + i] ? 1 : 0);
  return h;
}

static const Sprite *findSprite(uint32_t h) {
  for (int i = 0; i < SPRITE_COUNT; i++)
    if (SPRITES[i].hash == h) return &SPRITES[i];
  return nullptr;
}

static void drawBits(const uint8_t *bits, int w, int h, int left, int top, bool flip, PixelFn px) {
  int stride = (w + 7) / 8;
  for (int r = 0; r < h; r++)
    for (int c = 0; c < w; c++)
      if (bits[r * stride + c / 8] & (0x80 >> (c % 8))) {
        int x = left + (flip ? w - 1 - c : c), y = top + r;
        if (x >= 0 && x < SW && y >= 0 && y < SH) px(x, y);
      }
}

// ---------- capture mode ----------

#if CAPTURE
const int LOG_MAX = 1024;               // 4 KB of RAM; the R4 has 32 KB
static uint32_t logged[LOG_MAX];
static int loggedCount = 0;

// Prints e.g.
//   SHAPE 1a2b3c4d 12 14 03c0 0ff0 ...      <- machine-readable (one hex word per row)
//     ....####....
//     ..########..                          <- picture so you can tell what it is
static void logShape(const uint8_t lcd[TH][TW], int x0, int x1, int y0, int y1, bool mirror,
                     uint32_t h, LogFn log) {
  int w0 = x1 - x0 + 1, h0 = y1 - y0 + 1;
  if (!CAPTURE_ALL && (w0 < 4 || w0 > 16 || h0 < 3)) return;   // text, digits, specks
  for (int i = 0; i < loggedCount; i++) if (logged[i] == h) return;
  if (loggedCount == LOG_MAX) return;     // list full: stop rather than repeat
  logged[loggedCount++] = h;

  char line[300];
  int w = x1 - x0 + 1, n;
  n = snprintf(line, sizeof line, "SHAPE %08lx %d %d", (unsigned long)h, w, y1 - y0 + 1);
  for (int y = y0; y <= y1; y++) {
    uint32_t row = 0;
    for (int i = 0; i < w; i++) row = (row << 1) | (lcd[y][mirror ? x1 - i : x0 + i] ? 1 : 0);
    n += snprintf(line + n, sizeof line - n, " %lx", (unsigned long)row);
  }
  log(line);
  for (int y = y0; y <= y1; y++) {
    char art[40] = "  ";
    for (int i = 0; i < w; i++) art[2 + i] = lcd[y][mirror ? x1 - i : x0 + i] ? '#' : '.';
    art[2 + w] = 0;
    log(art);
  }
}
#endif

// ---------- one object ----------

static void drawObject(const uint8_t lcd[TH][TW], int x0, int x1, PixelFn px, LogFn log) {
  int y0 = TH, y1 = -1;
  for (int y = 0; y < TH; y++)
    for (int x = x0; x <= x1; x++)
      if (lcd[y][x]) { if (y < y0) y0 = y; y1 = y; }
  if (y1 < 0) return;

  // Use whichever facing gives the smaller hash, so both directions share one drawing.
  uint32_t hn = shapeHash(lcd, x0, x1, y0, y1, false);
  uint32_t hm = shapeHash(lcd, x0, x1, y0, y1, true);
  bool mirrored = hm < hn;
  uint32_t h = mirrored ? hm : hn;

  if (const Sprite *s = findSprite(h)) {
    // Line up the bottom-centre of the drawing with the bottom-centre of the original.
    int cx = OX + ((x0 + x1 + 1) * SCALE) / 2;
    int bottom = OY + (y1 + 1) * SCALE;
    drawBits(s->bits, s->w, s->h, cx - s->w / 2, bottom - s->h, mirrored, px);
    return;
  }

  for (int y = y0; y <= y1; y++)             // original pixels, scaled up
    for (int x = x0; x <= x1; x++)
      if (lcd[y][x])
        for (int dy = 0; dy < SCALE; dy++)
          for (int dx = 0; dx < SCALE; dx++) px(OX + x * SCALE + dx, OY + y * SCALE + dy);

#if CAPTURE
  logShape(lcd, x0, x1, y0, y1, mirrored, h, log);
#else
  (void)log;
#endif
}

// ---------- whole frame ----------

static void drawIcons(const bool icons[8], PixelFn px) {
  // Icons 0-3 along the top edge, 4-7 along the bottom edge.
  for (int i = 0; i < 8; i++) {
    int x = (i % 4) * 32 + 12, y = i < 4 ? 0 : SH - 8;
    if (icons[i]) drawBits(ICONS[i], 8, 8, x, y, false, px);
    else px(x + 3, y + (i < 4 ? 0 : 7));     // small dot marks the slot
  }
}

static void renderFrame(const uint8_t lcd[TH][TW], const bool icons[8], PixelFn px, LogFn log) {
  int start = -1;
  for (int x = 0; x <= TW; x++) {
    bool any = false;
    if (x < TW) for (int y = 0; y < TH; y++) any |= lcd[y][x] != 0;
    if (any && start < 0) start = x;
    if (!any && start >= 0) { drawObject(lcd, start, x - 1, px, log); start = -1; }
  }
  drawIcons(icons, px);
}

}  // namespace tama
